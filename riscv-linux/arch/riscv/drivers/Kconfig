## riscv-linux/arch/riscv/drivers/Kconfig
```kconfig
config ETH_XILINX_RV
	bool "Xilinx AXI dummy eth support for RV"
	depends on RISCV
	help
  Say 'Y' here if you want kernel to support the Xilinx AXI dummy eth driver.
```
